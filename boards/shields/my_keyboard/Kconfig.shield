## config/west.yml
```yaml
manifest:
  remotes:
    - name: zmkfirmware
      url-base: https://github.com/zmkfirmware
    - name: splitkb
      url-base: https://github.com/splitkb
    # Additional modules containing boards/shields/custom code can be listed here as well
    # See https://docs.zephyrproject.org/3.2.0/develop/west/manifest.html#projects
  projects:
    - name: zmk
      remote: zmkfirmware
      revision: v0.3
      import: app/west.yml
    - name: nv-gem
      url: https://github.com/MechboardsLTD/zmk-module
      revision: nv_gem
    - name: zmk-halcyon-module
      remote: splitkb
      revision: v0.3
  self:
    path: config
```
